## meta-xcpng/conf/layer.conf
```bitbake
# We have a conf and classes directory, add to BBPATH
BBPATH =. "${LAYERDIR}:"

# We have recipes-* directories, add to BBFILES
BBFILES += "${LAYERDIR}/recipes-*/*.bb \
            ${LAYERDIR}/recipes-*/*.bbappend"

BBFILE_COLLECTIONS += "xcpng"
BBFILE_PATTERN_xcpng = "^${LAYERDIR}/"
BBFILE_PRIORITY_xcpng = "5"

LAYERSERIES_COMPAT_xcpng = "alma10"

# This should only be incremented on significant changes that will
# cause compatibility issues with other layers
LAYERVERSION_xcpng = "1"

LAYERDEPENDS_xcpng = "dnf-bridge"


# FIXME those should rather be pulled by build-env
HOSTTOOLS += " \
    podman \
    newgidmap newuidmap pasta slirp4netns \
    createrepo_c \
    curl \
"

# Configuration for podman
CONTAINER_ARCH ?= "unset"
CONTAINER_ARCH:x86_64 = "linux/amd64"
CONTAINER_ARCH:x86_64_v2 = "linux/amd64/v2"
CONTAINER_ARCH:aarch64 = "linux/aarch64"


# alternatives configuration

PREFERRED_RPROVIDER_virtual/ant-jdk-binding = "ant-unbound"
PREFERRED_RPROVIDER_virtual/cim-server = "sblim-sfcb"
PREFERRED_RPROVIDER_virtual/dailyjobs = "cronie-noanacron"
PREFERRED_RPROVIDER_virtual/emacs_bin_ = "emacs"
PREFERRED_RPROVIDER_virtual/font_notosans_ = "google-noto-sans-fonts"
PREFERRED_RPROVIDER_virtual/font_redhatdisplay_ = "redhat-display-fonts"
PREFERRED_RPROVIDER_virtual/font_redhattext_ = "redhat-text-fonts"
PREFERRED_RPROVIDER_virtual/google-noto-sans-balinese-fonts = "google-noto-sans-balinese-fonts"
PREFERRED_RPROVIDER_virtual/google-noto-serif-myanmar-vf-fonts = "google-noto-sans-myanmar-vf-fonts"
PREFERRED_RPROVIDER_virtual/kernel = "kernel"
PREFERRED_RPROVIDER_virtual/kernel-uname-r = "kernel-core"
PREFERRED_RPROVIDER_virtual/kmod_cuse.ko_ = "kernel-modules-extra"
PREFERRED_RPROVIDER_virtual/libcurl = "libcurl"
PREFERRED_RPROVIDER_virtual/libcurl.so.4___64bit_ = "${PREFERRED_RPROVIDER_virtual/libcurl}"
PREFERRED_RPROVIDER_virtual/libcurl_x86-64_ = "${PREFERRED_RPROVIDER_virtual/libcurl}"
PREFERRED_RPROVIDER_virtual/libnode.so.127___64bit_ = "nodejs-libs"
PREFERRED_RPROVIDER_virtual/libtiffxx.so.6___64bit_ = "libtiff"
PREFERRED_RPROVIDER_virtual/libverto-module-base = "libverto-libev"
PREFERRED_RPROVIDER_virtual/lorax-templates = "lorax-templates-generic"
PREFERRED_RPROVIDER_virtual/maven-jdk-binding = "maven-unbound"
PREFERRED_RPROVIDER_virtual/nodejs_engine_ = "nodejs"
PREFERRED_RPROVIDER_virtual/opencryptoki_token_ = "opencryptoki-swtok"
PREFERRED_RPROVIDER_virtual/pinentry-gui = "pinentry-gnome3"
PREFERRED_RPROVIDER_virtual/pulseaudio-module-bluetooth = "pipewire-pulseaudio"
PREFERRED_RPROVIDER_virtual/SDL2_x86-64_ = "SDL2"
PREFERRED_RPROVIDER_virtual/libSDL2-2.0.so.0___64bit_ = "SDL2"
PREFERRED_RPROVIDER_virtual/selinux-policy-any = "selinux-policy-minimum"
PREFERRED_RPROVIDER_virtual/syslog = "systemd"
PREFERRED_RPROVIDER_virtual/tex_count1to.sty_ = "texlive-count1to"
PREFERRED_RPROVIDER_virtual/tex_everyshi.sty_ = "texlive-everyshi"
PREFERRED_RPROVIDER_virtual/tex_ragged2e.sty_ = "texlive-ragged2e"
PREFERRED_RPROVIDER_virtual/texlive-latex = "texlive-latex"
PREFERRED_RPROVIDER_virtual/text-www-browser = "elinks"
PREFERRED_RPROVIDER_virtual//usr/bin/gdb-add-index = "gdb-headless"
PREFERRED_RPROVIDER_virtual//usr/bin/node-22 = "nodejs"
PREFERRED_RPROVIDER_virtual//usr/bin/stap = "systemtap-client"

PREFERRED_RPROVIDER_virtual/glibc-langpack = "glibc-minimal-langpack"
PREFERRED_RPROVIDER_virtual/glibc-langpack-en_or_glibc-all-langpacks = "glibc-langpack-en"

PREFERRED_RPROVIDER_virtual/nfs-utils_or_nfsv4-client-utils = "nfs-utils"
PREFERRED_RPROVIDER_virtual/util-linux-core_or_util-linux = "util-linux"
PREFERRED_RPROVIDER_virtual/wget_or_curl = "curl"
PREFERRED_RPROVIDER_virtual/weston_or_cage_or_kwin-wayland_or_mutter_or_gnome-kiosk = "gnome-kiosk"

PREFERRED_RPROVIDER_virtual/coreutils = "coreutils"
PREFERRED_RPROVIDER_virtual//usr/bin/basename = "${PREFERRED_RPROVIDER_virtual/coreutils}"
PREFERRED_RPROVIDER_virtual//usr/bin/cat = "${PREFERRED_RPROVIDER_virtual/coreutils}"
PREFERRED_RPROVIDER_virtual//usr/bin/chmod = "${PREFERRED_RPROVIDER_virtual/coreutils}"
PREFERRED_RPROVIDER_virtual//usr/bin/date = "${PREFERRED_RPROVIDER_virtual/coreutils}"
PREFERRED_RPROVIDER_virtual//usr/bin/env = "${PREFERRED_RPROVIDER_virtual/coreutils}"
PREFERRED_RPROVIDER_virtual//usr/bin/readlink = "${PREFERRED_RPROVIDER_virtual/coreutils}"
PREFERRED_RPROVIDER_virtual//usr/bin/sha512sum = "${PREFERRED_RPROVIDER_virtual/coreutils}"

# FIXME: some of those may be wrong
PREFERRED_OCAML_LIBS = "ocaml-runtime"
PREFERRED_RPROVIDER_virtual/ocaml_CamlinternalFormat_ = "${PREFERRED_OCAML_LIBS}"
PREFERRED_RPROVIDER_virtual/ocaml_CamlinternalFormatBasics_ = "${PREFERRED_OCAML_LIBS}"
PREFERRED_RPROVIDER_virtual/ocaml_CamlinternalLazy_ = "${PREFERRED_OCAML_LIBS}"
PREFERRED_RPROVIDER_virtual/ocaml_CamlinternalOO_ = "${PREFERRED_OCAML_LIBS}"
PREFERRED_RPROVIDER_virtual/ocaml_Dynlink_ = "${PREFERRED_OCAML_LIBS}"
PREFERRED_RPROVIDER_virtual/ocaml_FilePath_ = "${PREFERRED_OCAML_LIBS}"
PREFERRED_RPROVIDER_virtual/ocaml_Stdlib_ = "${PREFERRED_OCAML_LIBS}"
PREFERRED_RPROVIDER_virtual/ocaml_Stdlib__Arg_ = "${PREFERRED_OCAML_LIBS}"
PREFERRED_RPROVIDER_virtual/ocaml_Stdlib__Array_ = "${PREFERRED_OCAML_LIBS}"
PREFERRED_RPROVIDER_virtual/ocaml_Stdlib__ArrayLabels_ = "${PREFERRED_OCAML_LIBS}"
PREFERRED_RPROVIDER_virtual/ocaml_Stdlib__Bigarray_ = "${PREFERRED_OCAML_LIBS}"
PREFERRED_RPROVIDER_virtual/ocaml_Stdlib__Buffer_ = "${PREFERRED_OCAML_LIBS}"
PREFERRED_RPROVIDER_virtual/ocaml_Stdlib__Bytes_ = "${PREFERRED_OCAML_LIBS}"
PREFERRED_RPROVIDER_virtual/ocaml_Stdlib__BytesLabels_ = "${PREFERRED_OCAML_LIBS}"
PREFERRED_RPROVIDER_virtual/ocaml_Stdlib__Callback_ = "${PREFERRED_OCAML_LIBS}"
PREFERRED_RPROVIDER_virtual/ocaml_Stdlib__Char_ = "${PREFERRED_OCAML_LIBS}"
PREFERRED_RPROVIDER_virtual/ocaml_Stdlib__Complex_ = "${PREFERRED_OCAML_LIBS}"
PREFERRED_RPROVIDER_virtual/ocaml_Stdlib__Condition_ = "${PREFERRED_OCAML_LIBS}"
PREFERRED_RPROVIDER_virtual/ocaml_Stdlib__Digest_ = "${PREFERRED_OCAML_LIBS}"
PREFERRED_RPROVIDER_virtual/ocaml_Stdlib__Domain_ = "${PREFERRED_OCAML_LIBS}"
PREFERRED_RPROVIDER_virtual/ocaml_Stdlib__Either_ = "${PREFERRED_OCAML_LIBS}"
PREFERRED_RPROVIDER_virtual/ocaml_Stdlib__Filename_ = "${PREFERRED_OCAML_LIBS}"
PREFERRED_RPROVIDER_virtual/ocaml_Stdlib__Float_ = "${PREFERRED_OCAML_LIBS}"
PREFERRED_RPROVIDER_virtual/ocaml_Stdlib__Format_ = "${PREFERRED_OCAML_LIBS}"
PREFERRED_RPROVIDER_virtual/ocaml_Stdlib__Fun_ = "${PREFERRED_OCAML_LIBS}"
PREFERRED_RPROVIDER_virtual/ocaml_Stdlib__Gc_ = "${PREFERRED_OCAML_LIBS}"
PREFERRED_RPROVIDER_virtual/ocaml_Stdlib__Hashtbl_ = "${PREFERRED_OCAML_LIBS}"
PREFERRED_RPROVIDER_virtual/ocaml_Stdlib__In_channel_ = "${PREFERRED_OCAML_LIBS}"
PREFERRED_RPROVIDER_virtual/ocaml_Stdlib__Int_ = "${PREFERRED_OCAML_LIBS}"
PREFERRED_RPROVIDER_virtual/ocaml_Stdlib__Int32_ = "${PREFERRED_OCAML_LIBS}"
PREFERRED_RPROVIDER_virtual/ocaml_Stdlib__Int64_ = "${PREFERRED_OCAML_LIBS}"
PREFERRED_RPROVIDER_virtual/ocaml_Stdlib__Lazy_ = "${PREFERRED_OCAML_LIBS}"
PREFERRED_RPROVIDER_virtual/ocaml_Stdlib__Lexing_ = "${PREFERRED_OCAML_LIBS}"
PREFERRED_RPROVIDER_virtual/ocaml_Stdlib__List_ = "${PREFERRED_OCAML_LIBS}"
PREFERRED_RPROVIDER_virtual/ocaml_Stdlib__ListLabels_ = "${PREFERRED_OCAML_LIBS}"
PREFERRED_RPROVIDER_virtual/ocaml_Stdlib__Map_ = "${PREFERRED_OCAML_LIBS}"
PREFERRED_RPROVIDER_virtual/ocaml_Stdlib__Marshal_ = "${PREFERRED_OCAML_LIBS}"
PREFERRED_RPROVIDER_virtual/ocaml_Stdlib__MoreLabels_ = "${PREFERRED_OCAML_LIBS}"
PREFERRED_RPROVIDER_virtual/ocaml_Stdlib__Mutex_ = "${PREFERRED_OCAML_LIBS}"
PREFERRED_RPROVIDER_virtual/ocaml_Stdlib__Nativeint_ = "${PREFERRED_OCAML_LIBS}"
PREFERRED_RPROVIDER_virtual/ocaml_Stdlib__Obj_ = "${PREFERRED_OCAML_LIBS}"
PREFERRED_RPROVIDER_virtual/ocaml_Stdlib__Option_ = "${PREFERRED_OCAML_LIBS}"
PREFERRED_RPROVIDER_virtual/ocaml_Stdlib__Out_channel_ = "${PREFERRED_OCAML_LIBS}"
PREFERRED_RPROVIDER_virtual/ocaml_Stdlib__Parsing_ = "${PREFERRED_OCAML_LIBS}"
PREFERRED_RPROVIDER_virtual/ocaml_Stdlib__Printexc_ = "${PREFERRED_OCAML_LIBS}"
PREFERRED_RPROVIDER_virtual/ocaml_Stdlib__Printf_ = "${PREFERRED_OCAML_LIBS}"
PREFERRED_RPROVIDER_virtual/ocaml_Stdlib__Queue_ = "${PREFERRED_OCAML_LIBS}"
PREFERRED_RPROVIDER_virtual/ocaml_Stdlib__Random_ = "${PREFERRED_OCAML_LIBS}"
PREFERRED_RPROVIDER_virtual/ocaml_Stdlib__Result_ = "${PREFERRED_OCAML_LIBS}"
PREFERRED_RPROVIDER_virtual/ocaml_Stdlib__Scanf_ = "${PREFERRED_OCAML_LIBS}"
PREFERRED_RPROVIDER_virtual/ocaml_Stdlib__Set_ = "${PREFERRED_OCAML_LIBS}"
PREFERRED_RPROVIDER_virtual/ocaml_Stdlib__Seq_ = "${PREFERRED_OCAML_LIBS}"
PREFERRED_RPROVIDER_virtual/ocaml_Stdlib__Stack_ = "${PREFERRED_OCAML_LIBS}"
PREFERRED_RPROVIDER_virtual/ocaml_Stdlib__StdLabels_ = "${PREFERRED_OCAML_LIBS}"
PREFERRED_RPROVIDER_virtual/ocaml_Stdlib__String_ = "${PREFERRED_OCAML_LIBS}"
PREFERRED_RPROVIDER_virtual/ocaml_Stdlib__StringLabels_ = "${PREFERRED_OCAML_LIBS}"
PREFERRED_RPROVIDER_virtual/ocaml_Stdlib__Sys_ = "${PREFERRED_OCAML_LIBS}"
PREFERRED_RPROVIDER_virtual/ocaml_Stdlib__Uchar_ = "${PREFERRED_OCAML_LIBS}"
PREFERRED_RPROVIDER_virtual/ocaml_Str_ = "${PREFERRED_OCAML_LIBS}"
PREFERRED_RPROVIDER_virtual/ocaml_Thread_ = "${PREFERRED_OCAML_LIBS}"
PREFERRED_RPROVIDER_virtual/ocaml_Unix_ = "${PREFERRED_OCAML_LIBS}"
PREFERRED_RPROVIDER_virtual/ocaml_UnixLabels_ = "${PREFERRED_OCAML_LIBS}"

PREFERRED_RPROVIDER_virtual/ocaml_Dyn_ = "ocaml-dyn"
PREFERRED_RPROVIDER_virtual/ocaml_FileUtil_ = "ocaml-fileutils"
PREFERRED_RPROVIDER_virtual/ocaml_Ordering_ = "ocaml-ordering"
PREFERRED_RPROVIDER_virtual/ocaml_Pp_ = "${PREFERRED_RPROVIDER_virtual/ocaml_Dyn_}"
PREFERRED_RPROVIDER_virtual/ocaml_Xdg_ = "ocaml-xdg"

PREFERRED_RPROVIDER_virtual/ocaml_Dune_filesystem_stubs_ = "ocaml-dune-private-libs"
PREFERRED_RPROVIDER_virtual/ocaml_Dune_meta_parser_ = "ocaml-dune-private-libs"
PREFERRED_RPROVIDER_virtual/ocaml_Dune_meta_parser__Meta_lexer_ = "ocaml-dune-private-libs"
PREFERRED_RPROVIDER_virtual/ocaml_Dune_meta_parser__Meta_parser_ = "ocaml-dune-private-libs"
PREFERRED_RPROVIDER_virtual/ocaml_Dune_re_ = "ocaml-dune-private-libs"
PREFERRED_RPROVIDER_virtual/ocaml_Dune_re___ = "ocaml-dune-private-libs"
PREFERRED_RPROVIDER_virtual/ocaml_Dune_re__Automata_ = "ocaml-dune-private-libs"
PREFERRED_RPROVIDER_virtual/ocaml_Dune_re__Category_ = "ocaml-dune-private-libs"
PREFERRED_RPROVIDER_virtual/ocaml_Dune_re__Core_ = "ocaml-dune-private-libs"
PREFERRED_RPROVIDER_virtual/ocaml_Dune_re__Cset_ = "ocaml-dune-private-libs"
PREFERRED_RPROVIDER_virtual/ocaml_Dune_re__Pmark_ = "ocaml-dune-private-libs"
PREFERRED_RPROVIDER_virtual/ocaml_Dune_re__Re_ = "ocaml-dune-private-libs"
PREFERRED_RPROVIDER_virtual/ocaml_Dune_section_ = "ocaml-dune-private-libs"

PREFERRED_RPROVIDER_virtual/ocaml_Dune_glob_ = "ocaml-dune-glob"
PREFERRED_RPROVIDER_virtual/ocaml_Dune_glob___ = "ocaml-dune-glob"
PREFERRED_RPROVIDER_virtual/ocaml_Dune_glob__Glob_ = "ocaml-dune-glob"

PREFERRED_RPROVIDER_virtual/ocaml_Dune_rpc_private_ = "ocaml-dune-rpc"
PREFERRED_RPROVIDER_virtual/ocaml_Dune_rpc_private___ = "ocaml-dune-rpc"
PREFERRED_RPROVIDER_virtual/ocaml_Dune_rpc_private__Conv_ = "ocaml-dune-rpc"
PREFERRED_RPROVIDER_virtual/ocaml_Dune_rpc_private__Exported_types_ = "ocaml-dune-rpc"
PREFERRED_RPROVIDER_virtual/ocaml_Dune_rpc_private__Fiber_intf_ = "ocaml-dune-rpc"
PREFERRED_RPROVIDER_virtual/ocaml_Dune_rpc_private__Import_ = "ocaml-dune-rpc"
PREFERRED_RPROVIDER_virtual/ocaml_Dune_rpc_private__Registry_ = "ocaml-dune-rpc"
PREFERRED_RPROVIDER_virtual/ocaml_Dune_rpc_private__Where_ = "ocaml-dune-rpc"

PREFERRED_OCAML_STDUNE="ocaml-stdune"
PREFERRED_RPROVIDER_virtual/ocaml_Csexp_ = "${PREFERRED_OCAML_STDUNE}"
PREFERRED_RPROVIDER_virtual/ocaml_Stdune_ = "${PREFERRED_OCAML_STDUNE}"
PREFERRED_RPROVIDER_virtual/ocaml_Stdune___ = "${PREFERRED_OCAML_STDUNE}"
PREFERRED_RPROVIDER_virtual/ocaml_Stdune__Ansi_color_ = "${PREFERRED_OCAML_STDUNE}"
PREFERRED_RPROVIDER_virtual/ocaml_Stdune__Applicative_intf_ = "${PREFERRED_OCAML_STDUNE}"
PREFERRED_RPROVIDER_virtual/ocaml_Stdune__Code_error_ = "${PREFERRED_OCAML_STDUNE}"
PREFERRED_RPROVIDER_virtual/ocaml_Stdune__Comparable_ = "${PREFERRED_OCAML_STDUNE}"
PREFERRED_RPROVIDER_virtual/ocaml_Stdune__Comparable_intf_ = "${PREFERRED_OCAML_STDUNE}"
PREFERRED_RPROVIDER_virtual/ocaml_Stdune__Comparator_ = "${PREFERRED_OCAML_STDUNE}"
PREFERRED_RPROVIDER_virtual/ocaml_Stdune__Dune_either_ = "${PREFERRED_OCAML_STDUNE}"
PREFERRED_RPROVIDER_virtual/ocaml_Stdune__Either_ = "${PREFERRED_OCAML_STDUNE}"
PREFERRED_RPROVIDER_virtual/ocaml_Stdune__Env_ = "${PREFERRED_OCAML_STDUNE}"
PREFERRED_RPROVIDER_virtual/ocaml_Stdune__Exn_ = "${PREFERRED_OCAML_STDUNE}"
PREFERRED_RPROVIDER_virtual/ocaml_Stdune__Fdecl_ = "${PREFERRED_OCAML_STDUNE}"
PREFERRED_RPROVIDER_virtual/ocaml_Stdune__Filename_ = "${PREFERRED_OCAML_STDUNE}"
PREFERRED_RPROVIDER_virtual/ocaml_Stdune__Fpath_ = "${PREFERRED_OCAML_STDUNE}"
PREFERRED_RPROVIDER_virtual/ocaml_Stdune__Hashable_ = "${PREFERRED_OCAML_STDUNE}"
PREFERRED_RPROVIDER_virtual/ocaml_Stdune__Hashtbl_ = "${PREFERRED_OCAML_STDUNE}"
PREFERRED_RPROVIDER_virtual/ocaml_Stdune__Hashtbl_intf_ = "${PREFERRED_OCAML_STDUNE}"
PREFERRED_RPROVIDER_virtual/ocaml_Stdune__Int_ = "${PREFERRED_OCAML_STDUNE}"
PREFERRED_RPROVIDER_virtual/ocaml_Stdune__Io_ = "${PREFERRED_OCAML_STDUNE}"
PREFERRED_RPROVIDER_virtual/ocaml_Stdune__Io_intf_ = "${PREFERRED_OCAML_STDUNE}"
PREFERRED_RPROVIDER_virtual/ocaml_Stdune__Lexbuf_ = "${PREFERRED_OCAML_STDUNE}"
PREFERRED_RPROVIDER_virtual/ocaml_Stdune__List_ = "${PREFERRED_OCAML_STDUNE}"
PREFERRED_RPROVIDER_virtual/ocaml_Stdune__Loc_ = "${PREFERRED_OCAML_STDUNE}"
PREFERRED_RPROVIDER_virtual/ocaml_Stdune__Loc0_ = "${PREFERRED_OCAML_STDUNE}"
PREFERRED_RPROVIDER_virtual/ocaml_Stdune__Map_ = "${PREFERRED_OCAML_STDUNE}"
PREFERRED_RPROVIDER_virtual/ocaml_Stdune__Map_intf_ = "${PREFERRED_OCAML_STDUNE}"
PREFERRED_RPROVIDER_virtual/ocaml_Stdune__Monad_ = "${PREFERRED_OCAML_STDUNE}"
PREFERRED_RPROVIDER_virtual/ocaml_Stdune__Monad_intf_ = "${PREFERRED_OCAML_STDUNE}"
PREFERRED_RPROVIDER_virtual/ocaml_Stdune__Monoid_intf_ = "${PREFERRED_OCAML_STDUNE}"
PREFERRED_RPROVIDER_virtual/ocaml_Stdune__Option_ = "${PREFERRED_OCAML_STDUNE}"
PREFERRED_RPROVIDER_virtual/ocaml_Stdune__Path_ = "${PREFERRED_OCAML_STDUNE}"
PREFERRED_RPROVIDER_virtual/ocaml_Stdune__Path_intf_ = "${PREFERRED_OCAML_STDUNE}"
PREFERRED_RPROVIDER_virtual/ocaml_Stdune__Per_item_intf_ = "${PREFERRED_OCAML_STDUNE}"
PREFERRED_RPROVIDER_virtual/ocaml_Stdune__Poly_ = "${PREFERRED_OCAML_STDUNE}"
PREFERRED_RPROVIDER_virtual/ocaml_Stdune__Result_ = "${PREFERRED_OCAML_STDUNE}"
PREFERRED_RPROVIDER_virtual/ocaml_Stdune__Seq_ = "${PREFERRED_OCAML_STDUNE}"
PREFERRED_RPROVIDER_virtual/ocaml_Stdune__Set_ = "${PREFERRED_OCAML_STDUNE}"
PREFERRED_RPROVIDER_virtual/ocaml_Stdune__Set_intf_ = "${PREFERRED_OCAML_STDUNE}"
PREFERRED_RPROVIDER_virtual/ocaml_Stdune__Sexp_ = "${PREFERRED_OCAML_STDUNE}"
PREFERRED_RPROVIDER_virtual/ocaml_Stdune__Staged_ = "${PREFERRED_OCAML_STDUNE}"
PREFERRED_RPROVIDER_virtual/ocaml_Stdune__String_ = "${PREFERRED_OCAML_STDUNE}"
PREFERRED_RPROVIDER_virtual/ocaml_Stdune__Table_ = "${PREFERRED_OCAML_STDUNE}"
PREFERRED_RPROVIDER_virtual/ocaml_Stdune__Top_closure_intf_ = "${PREFERRED_OCAML_STDUNE}"
PREFERRED_RPROVIDER_virtual/ocaml_Stdune__Univ_map_ = "${PREFERRED_OCAML_STDUNE}"
PREFERRED_RPROVIDER_virtual/ocaml_Stdune__Univ_map_intf_ = "${PREFERRED_OCAML_STDUNE}"
PREFERRED_RPROVIDER_virtual/ocaml_Stdune__User_error_ = "${PREFERRED_OCAML_STDUNE}"
PREFERRED_RPROVIDER_virtual/ocaml_Stdune__User_message_ = "${PREFERRED_OCAML_STDUNE}"

PREFERRED_RPROVIDER_virtual/mvn_org.apache.tomcat_tomcat-catalina_ = "tomcat-lib"
PREFERRED_RPROVIDER_virtual/mvn_org.apache.tomcat_tomcat-coyote_ = "tomcat-lib"
PREFERRED_RPROVIDER_virtual/mvn_org.apache.tomcat_tomcat-el-api_ = "tomcat-el-3.0-api"
PREFERRED_RPROVIDER_virtual/mvn_org.apache.tomcat_tomcat-juli_ = "tomcat-lib"
PREFERRED_RPROVIDER_virtual/mvn_org.apache.tomcat_tomcat-jsp-api_ = "tomcat-jsp-2.3-api"
PREFERRED_RPROVIDER_virtual/mvn_org.apache.tomcat_tomcat-servlet-api_ = "tomcat-servlet-6.0-api"
```
